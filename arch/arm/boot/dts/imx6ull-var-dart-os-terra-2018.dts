/*
 * Copyright (C) 2020 CompeGPS Team S.L.
 * All rights reserved
 *
 */

#define WIFI
#define EMMC

#include "terra-2018-common.dtsi"

/ {
	model = "os-terra-2018";
	compatible = "fsl,imx6ull-var-dart", "fsl,imx6ull";
};

