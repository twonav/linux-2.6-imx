/*
 * Copyright (C) 2020 CompeGPS Team S.L.
 * All rights reserved
 *
 */

#define WIFI
#define EMMC

#include "crosskyo-2018-specific.dtsi"

/ {
	model = "TwoNav Stonehenge i.MX6 Cross Kyocera";
	compatible = "fsl,imx6ull-var-dart", "fsl,imx6ull";
};

