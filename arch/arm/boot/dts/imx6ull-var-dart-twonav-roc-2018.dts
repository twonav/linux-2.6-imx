/*
 * Copyright (C) 2020 CompeGPS Team S.L.
 * All rights reserved
 *
 */

#define WIFI
#define EMMC

#include "roc-2018-common.dtsi"

/ {
	model = "twonav-roc-2018";
	compatible = "fsl,imx6ull-var-dart", "fsl,imx6ull";
};

