/*
 * Copyright (C) 2020 CompeGPS Team S.L.
 * All rights reserved
 *
 */
/dts-v1/;

#include <dt-bindings/input/input.h>
#include "imx6ull.dtsi"
#include "imx6ul-imx6ull-var-dart-common.dtsi"
#include "stonehenge-big-common.dtsi"
#include "wireless-murata-sd8987.dtsi"
