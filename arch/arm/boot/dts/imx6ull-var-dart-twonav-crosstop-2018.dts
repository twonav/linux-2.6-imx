/*
 * Copyright (C) 2020 CompeGPS Team S.L.
 * All rights reserved
 *
 */

#define WIFI
#define EMMC

#include "crosstop-2018-common.dtsi"

/ {
	model = "twonav-crosstop-2018";
	compatible = "fsl,imx6ull-var-dart", "fsl,imx6ull";
};

